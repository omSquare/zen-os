## Kconfig
```kconfig
mainmenu "Zephyr configuration"
source "$(ZEPHYR_BASE)/Kconfig.zephyr"

mainmenu "Zen-OS configuration"

rsource "Kconfig.zenos"
```

## ext/micropython/Kconfig
```kconfig
config MICROPYTHON
	bool "Integrate Micropython interpreter"
	default n
	select NEWLIB_LIBC
	help
	This option enable to use Python language in your application.
```
